/*@!Encoding:65001*/
includes
{
  
}

variables
{  
  int result = 0;
  dword timeout = 2000;
}

export testfunction PepareTestscenarioAdvalues()
{
  KeyA::Receiver.Connect();
  KeyA::Sender.Connect();
  resetDistObjValues(KeyA::Receiver);  
  $KeyA::Sender.toVoltage15 = 3;
  $KeyA::Sender.toPIN12Value = 1;
}

// Tests for int16 type
export testcase DO_CheckAdvaluesMatchInt16()
{  
  int expectedValue = 3;
  
  result = testWaitForPhysValueInRangeSInt(KeyA::Receiver.fromVoltage15, expectedValue, expectedValue, timeout);

  if (result != 1)
  {
    TestStepFail("DO_AdvalueMatch", "FAILED: No value within timeout");
  }
  TestStepPass("DO_AdvalueMatch", "SUCCESS");
}

// Tests for uint8 type
export testCase DO_CheckAdvaluesMatchUint8()
{
  byte expectedValue = 1;
  
  result = testWaitForPhysValueInRangeSInt(KeyA::Receiver.fromPIN12Value, expectedValue, expectedValue, timeout);

  if (result != 1)
  {
    TestStepFail("DO_AdvalueMatch", "FAILED: Values do not match");
  }
  TestStepPass("DO_AdvalueMatch", "SUCCESS");
}
