/*@!Encoding:65001*/
includes
{
  
}

variables
{
  distObjRef GLIOAdapter in_object = KeyA::Receiver;
  distObjRef ValueSender out_object = KeyA::Sender;
  int result;
  dword timeout=2000;
}

export testfunction PepareTestscenarioChardev()
{
  out_object.Connect();

  $out_object.toFifo2 = "send_receive_test";
}

export testcase DO_CheckChardevMatch()
{
  in_object.Connect();

  result = testWaitForImplValueString(KeyA::Receiver.fromFifo2, "send_receive_test", timeout);
  if (result != 1)
  {
    TestStepFail("DO_AdvalueMatch", "FAILED: No value within timeout");
  }
  TestStepPass("DO_AdvalueMatch", "SUCCESS");
}
