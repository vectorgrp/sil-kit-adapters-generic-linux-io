/*@!Encoding:65001*/
includes
{
  
}

variables
{
  int result = 0;
  dword timeout = 2000;
}

export testfunction PepareTestscenarioChardev()
{
  KeyA::Receiver.Connect();
  KeyA::Sender.Connect();
  resetDistObjValues(KeyA::Receiver);

  $KeyA::Sender.toFifo2 = "send_receive_test";
}

export testcase DO_CheckChardevMatch()
{
  result = testWaitForImplValueString(KeyA::Receiver.fromFifo2, "send_receive_test", timeout);
  if (result != 1)
  {
    TestStepFail("DO_AdvalueMatch", "FAILED: No value within timeout");
  }
  TestStepPass("DO_AdvalueMatch", "SUCCESS");
}
