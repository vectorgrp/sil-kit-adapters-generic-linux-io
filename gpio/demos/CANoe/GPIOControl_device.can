/*@!Encoding:1252*/
includes
{
  
}

variables
{
  distObjRef KeyA::GPIOAdapter input_datas = KeyA::Receiver;
  distObjRef KeyA::ValueSender output_datas = KeyA::Sender;
  distObjRef KeyA::Update update_data = KeyA::UpdatedData;
}

on start {

}

on value_update KeyA::UpdatedData.updatedData
{
  int i;
  int line;
  
  line = $update_data.updatedData.line;
  
  for (i = 0; i < elCount($input_datas.adapterPublishTopic.values); i++)
  {
    if (i == line) 
    {
      $output_datas.adapterSubscribeTopic.values[i] = $update_data.updatedData.value;
      $output_datas.adapterSubscribeTopic.directions[i] = $update_data.updatedData.direction;
    }
    else
    {
      $output_datas.adapterSubscribeTopic.values[i] = $input_datas.adapterPublishTopic.values[i];
      $output_datas.adapterSubscribeTopic.directions[i] = $input_datas.adapterPublishTopic.directions[i];
    }
  }
}