/*@!Encoding:65001*/
includes
{
  
}

variables
{
  distObjRef GLIOAdapter in_object = KeyA::Receiver;
  distObjRef ValueSender out_object = KeyA::Sender;
  dword timeout=2000;
}

export testfunction PepareTestscenarioGpio()
{
  out_object.Connect();
  
  $out_object.toGpiochip0Line1.value = 0;
  $out_object.toGpiochip0Line1.direction = 1;
}

export testcase DO_CheckGpioMatch()
{
  int result;
  struct KeyA::RecvLineValue expectedValue;
  expectedValue.value = 0;
  expectedValue.direction = 1;
  
  in_object.Connect();

  result = testWaitForImplValue(KeyA::Receiver.fromGpiochip0Line1, expectedValue, timeout);

  if (result != 1)
  {
    TestStepFail("DO_AdvalueMatch", "FAILED: No value within timeout");
  }
  TestStepPass("DO_AdvalueMatch", "SUCCESS");
}
