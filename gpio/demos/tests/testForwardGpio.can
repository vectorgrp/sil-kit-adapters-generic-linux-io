/*@!Encoding:65001*/
includes
{
  
}

variables
{
    dword timeout=2000;
    int result;
}

export testfunction PepareTestscenarioGpio()
{
  KeyA::Receiver.Connect();
  KeyA::Sender.Connect();
  resetDistObjValues(KeyA::Receiver);

  $KeyA::Sender.toGpiochip0Line1.value = 1;
  $KeyA::Sender.toGpiochip0Line1.direction = 1;
}

export testcase DO_CheckGpioMatch()
{
  struct KeyA::RecvLineValue expectedValue;
  expectedValue.value = 1;
  expectedValue.direction = 1;

  result = testWaitForImplValue(KeyA::Receiver.fromGpiochip0Line1, expectedValue, timeout);
  if (result != 1)
  {
    TestStepFail("DO_AdvalueMatch", "FAILED: No value within timeout");
  }
  TestStepPass("DO_AdvalueMatch", "SUCCESS");
}
